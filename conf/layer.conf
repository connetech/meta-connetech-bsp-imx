## conf/layer.conf
```bitbake
# We have a conf and classes directory, add to BBPATH
BBPATH .= ":${LAYERDIR}"

# We have a packages directory, add to BBFILES
BBFILES += "${LAYERDIR}/recipes-*/*/*.bb \
            ${LAYERDIR}/recipes-*/*/*.bbappend"

BBFILE_COLLECTIONS += "connetech-bsp"
BBFILE_PATTERN_connetech-bsp := "^${LAYERDIR}/"
BBFILE_PRIORITY_connetech-bsp = "9"

LAYERSERIES_COMPAT_connetech-bsp = "kirkstone langdale mickledore"

LAYERDEPENDS_connetech-bsp = " \
    variscite-bsp-common \
    fsl-bsp-release \
"

BBFILES_DYNAMIC += " \
    meta-ml:${LAYERDIR}/dynamic-layers/meta-ml/*/*/*.bb \
    meta-ml:${LAYERDIR}/dynamic-layers/meta-ml/*/*/*.bbappend \
"
```
